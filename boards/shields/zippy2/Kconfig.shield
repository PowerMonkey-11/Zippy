## boards/shields/zippy2/Kconfig.shield
```kconfig
# Copyright (c) 2020 The ZMK Contributors
# SPDX-License-Identifier: MIT

config SHIELD_ZIPPY2_CENTRAL_DONGLE
	def_bool $(shields_list_contains,zippy2_central_dongle)

config SHIELD_ZIPPY2_CENTRAL_LEFT
    def_bool $(shields_list_contains,zippy2_central_left)

config SHIELD_ZIPPY2_PERIPHERAL_LEFT
    def_bool $(shields_list_contains,zippy2_peripheral_left)

config SHIELD_ZIPPY2_PERIPHERAL_RIGHT
    def_bool $(shields_list_contains,zippy2_peripheral_right)
```
